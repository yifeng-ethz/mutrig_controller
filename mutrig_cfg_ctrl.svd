# MU3E_MUTRIG_CFG_CTRL register map
Vendor: Mu3e; Series: MU3E_FPGA_IP; File version: 24.0.817
CMSIS-SVD description of the MuTRiG controller CSR aperture. BaseAddress is 0 because this file describes the relative CSR aperture of the IP; system integration supplies the live slave base address.
Registers are 32-bit, read-write, reset 0x0 unless marked. A register's access mark holds for its fields unless they carry their own. Offsets are from the block's base; lines under a group give offsets from that group; [hi:lo] are bit positions; {n}, {i} and the like mark numbered series; 'fields as' and 'values as' point back to an identical list; <NAME> marks a mode.

## Memory map
0x00000000 MUTRIG_CFG_CTRL_CSR size 0x10 — Relative 4-word command/status aperture for the MuTRiG controller.

## MUTRIG_CFG_CTRL_CSR — Relative 4-word command/status aperture for the MuTRiG controller.
Base 0x00000000
0x00 OPCODE_STATUS — MuTRiG command/status word. Writes latch a 32-bit opcode. Reads return zero while idle; while busy, bits [31:16] echo opcode[31:16] and bits [15:0] return the controller status word.
  [31:0] value — Raw mixed read/write command and status word.
0x04 OFFSET — Scratchpad/configuration memory offset word used by the MuTRiG controller RPC engine.
  [31:0] value — Raw 32-bit offset word.
0x08 MONITOR_SECONDS — Monitor integration interval in seconds for the MuTRiG controller counter logic.
  [15:0] seconds — Monitor interval in seconds.
0x0C RESERVED3 — Reserved fourth CSR word. Reads return zero. Writes are ignored.
  [31:0] value — Reserved raw word.
